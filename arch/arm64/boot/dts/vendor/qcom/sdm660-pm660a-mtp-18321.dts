/*
 * SDM660 PM660A MTP - Realme 2 Pro (18321)
 *
 * 移植来源: oppo sdm660 4.4 内核 18321/sdm660-pm660a-mtp-18321.dts
 * 目标内核: qcom sdm660 4.19
 *
 * qcom,board-id 第三段 (十进制 18321 = 0x4791) 是 Realme 2 Pro 型号代号,
 * bootloader 据此从 multi-dtb 选择匹配项。pmic-id 维持 oppo 原值 (3 组)。
 * model 字符串与 Q 时代出厂固件 (F12 dump) 完全一致 (含 "18321" 后缀)。
 *
 * include 链: 入口 -> sdm660.dtsi/sdm660-mtp.dtsi/msm-pm660a.dtsi/sdm660-internal-codec.dtsi
 *   (qcom 4.19 base) -> oppo/18321.dtsi (设备特有 + oppo/oppo-sdm660-common.dtsi 共性)。
 *
 * 板级硬件及 OPPO camera_v2 sensor/eeprom/flash 拓扑见 oppo/18321.dtsi 与
 * oppo/oppo-camera-18321.dtsi；触摸由 oppo_touchscreen 框架
 * (novatek NT36672 / himax HX83112A noflash) 提供；指纹、VOOC 和外置音频
 * 等其余内核驱动不属于 DTS 入口职责。
 *
 * RMX1801 兼容 eMMC (4/6GB) 与 UFS (8GB) 两种存储版本, 故 18321.dtsi 中
 * ufs1/ufsphy1/ufs_ice 保持 status = "okay"。
 *
 * 验证范围: cpp+dtc 编译及静态 DTB 对比；board-id/pmic-id 对齐 stock 最终 DTB。
 */

/dts-v1/;

#include "sdm660.dtsi"
#include "sdm660-mtp.dtsi"
#include "msm-pm660a.dtsi"
#include "sdm660-internal-codec.dtsi"
#include "oppo/18321.dtsi"

/ {
	model = "Qualcomm Technologies, Inc. SDM 660 PM660 + PM660A MTP 18321";
	compatible = "qcom,sdm660-mtp", "qcom,sdm660", "qcom,mtp";
	qcom,board-id = <8 0 18321>;
	qcom,pmic-id = <0x0001001b 0x0001011a 0x0 0x0>,
			<0x0001001b 0x0002001a 0x0 0x0>,
			<0x0001001b 0x0202001a 0x0 0x0>;
};
