## drivers/input/touchscreen/oppo_touchscreen/Himax/hx83112a_noflash/Kconfig
```kconfig
config TOUCHPANEL_HIMAX_HX83112A_NOFLASH
	bool "TP himax hx83112a no-flash IC enable or not for OPPO"
	depends on SPI
	---help---
	say Y to enable driver for Touchpanel using himax hx83112a no-flash
```

## drivers/input/touchscreen/oppo_touchscreen/Novatek/NT36672_noflash/Kconfig
```kconfig
config TOUCHPANEL_NOVA_NT36672_NOFLASH
	bool "TP nova nt36672 no-flash IC enable or not for OPPO"
	depends on SPI
	---help---
	say Y to enable driver for Touchpanel using nova nt36672 no-flash
```
